/**
 * Copyright (c) 2020 University of Applied Sciences Western Switzerland / Fribourg
 *
 * Permission is hereby granted, free of charge, to any person obtaining a copy
 * of this software and associated documentation files (the "Software"), to deal
 * in the Software without restriction, including without limitation the rights
 * to use, copy, modify, merge, publish, distribute, sublicense, and/or sell
 * copies of the Software, and to permit persons to whom the Software is
 * furnished to do so, subject to the following conditions:
 *
 * The above copyright notice and this permission notice shall be included in all
 * copies or substantial portions of the Software.
 *
 * THE SOFTWARE IS PROVIDED "AS IS", WITHOUT WARRANTY OF ANY KIND, EXPRESS OR
 * IMPLIED, INCLUDING BUT NOT LIMITED TO THE WARRANTIES OF MERCHANTABILITY,
 * FITNESS FOR A PARTICULAR PURPOSE AND NONINFRINGEMENT. IN NO EVENT SHALL THE
 * AUTHORS OR COPYRIGHT HOLDERS BE LIABLE FOR ANY CLAIM, DAMAGES OR OTHER
 * LIABILITY, WHETHER IN AN ACTION OF CONTRACT, TORT OR OTHERWISE, ARISING FROM,
 * OUT OF OR IN CONNECTION WITH THE SOFTWARE OR THE USE OR OTHER DEALINGS IN THE
 * SOFTWARE.
 *
 *
 * Project: HEIA-FR / Accélérateur de tour télécom
 *
 * Purpose: This module handles the USB interface and simulates a mass storage device with a FAT12 filesystem
 *
 * Author:  Nicolas Maier
 * Date:    June 2020
 */

#include <stddef.h>
#include <stdint.h>

#include "canonical_huffman/canonical_huffman.h"
#include "leds/leds.h"
#include "stm32f1xx_hal.h"
#include "usb.h"
#include "usb_device.h"

/**
 * This array contains the 4 first blocks of the storage device, which are used to describe the filesystem and it's file metadata
 * 
 * To generate this data, a script is provided in this project: realisation/filesystem/generate_fs.sh
 * 
 * Here is the information contained in this array:
 * - volume label: "TELE TOWER"
 * - device total size: 45 blocks of 512 bytes = 23040 bytes
 * - device usable space: 41 blocks of 512 bytes = 20992
 * - files:
 *   . "control": 512 bytes
 *   . "data": 20480 bytes
 */
// clang-format off
const uint8_t usb_filesystem_metadata[] = {
    0xeb, 0x3c, 0x90, 0x4d, 0x54, 0x4f, 0x4f, 0x34, 0x30, 0x31, 0x38, 0x0, 0x2, 0x1, 0x1, 0x0, 0x2, 0x10, 0x0, 0x7, 0x0, 0xf0, 0x1, 0x0, 0x7, 0x0, 0x1, 0x0, 0x0, 0x0, 0x0, 0x0,
    0x0, 0x0, 0x0, 0x0, 0x0, 0x0, 0x29, 0x74, 0xc2, 0x29, 0x6e, 0x54, 0x45, 0x4c, 0x45, 0x20, 0x54, 0x4f, 0x57, 0x45, 0x52, 0x20, 0x46, 0x41, 0x54, 0x31, 0x32, 0x20, 0x20, 0x20, 0xfa, 0x31,
    0xc0, 0x8e, 0xd8, 0x8e, 0xc0, 0xfc, 0xb9, 0x0, 0x1, 0xbe, 0x0, 0x7c, 0xbf, 0x0, 0x80, 0xf3, 0xa5, 0xea, 0x56, 0x0, 0x0, 0x8, 0xb8, 0x1, 0x2, 0xbb, 0x0, 0x7c, 0xba, 0x80, 0x0, 0xb9,
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    0x0, 0x0, 0x0, 0x0, 0x0, 0x0, 0x0, 0x0, 0x0, 0x0, 0x0, 0x0, 0x0, 0x0, 0x0, 0x0, 0x0, 0x0, 0x0, 0x0, 0x0, 0x0, 0x0, 0x0, 0x0, 0x0, 0x0, 0x0, 0x0, 0x0, 0x0, 0x0,
};
// clang-format on

#define CONFIG_FILE_BLOCK 4
#define CODING_FILE_BLOCK 5
#define DATA_FILE_BLOCK 6

volatile uint8_t coding_buffer[STORAGE_BLK_SIZ];

void usb_init() {
    memset((void *)coding_buffer, 0, STORAGE_BLK_SIZ);
    coding_buffer[0] = 1;
    for (size_t i = 0; i < 256; i++) {
        coding_buffer[256 + i] = i;
    }

    MX_USB_DEVICE_Init();
}

void usb_read(uint8_t *buffer, uint32_t block_address, uint16_t block_count) {
    for (size_t i = 0; i < block_count; i++) {

        if (block_address == DATA_FILE_BLOCK) {
            // "data" file isn't supposed to be read, fill with 0

            memset(buffer + i * STORAGE_BLK_SIZ, 0x00, STORAGE_BLK_SIZ);

        } else if (block_address == CODING_FILE_BLOCK) {
            // "coding" file isn't supposed to be read, fill with 0

            memset(buffer + i * STORAGE_BLK_SIZ, 0x00, STORAGE_BLK_SIZ);

        } else if (block_address == CONFIG_FILE_BLOCK) {
            // "config" file isn't supposed to be read, fill with 0

            memset(buffer + i * STORAGE_BLK_SIZ, 0x00, STORAGE_BLK_SIZ);

        } else if (block_address < 4) {
            // filesystem metadata

            memcpy(buffer + i * STORAGE_BLK_SIZ, (void *)(usb_filesystem_metadata + (STORAGE_BLK_SIZ * block_address)), STORAGE_BLK_SIZ);
        }

        block_address++;
    }
}

void usb_write(uint8_t *buffer, uint32_t block_address, uint16_t block_count) {
    // lower USB RX interrupt priority, to let DMA related interrupts preemptively interrupt this function
    HAL_NVIC_SetPriority(USB_LP_CAN1_RX0_IRQn, 1, 0);

    for (size_t i = 0; i < block_count; i++) {

        if (block_address == DATA_FILE_BLOCK) {
            // "data" file

            uint16_t offset = *((uint16_t *)buffer);
            uint16_t size = *((uint16_t *)(buffer + 2));
            bool do_show = buffer[4];

            leds_wait_dma_progress(offset + size);

            canonical_huffman_decode(coding_buffer, coding_buffer + 256, buffer + i * STORAGE_BLK_SIZ + 5, leds_usb_bit_buffer + offset, size);

            if (do_show) {
                leds_wait_sent();
                leds_send();
            }
        } else if (block_address == CODING_FILE_BLOCK) {
            // "coding" file

            memcpy((void *)(coding_buffer + (STORAGE_BLK_SIZ * (block_address - CODING_FILE_BLOCK))), buffer + i * STORAGE_BLK_SIZ, STORAGE_BLK_SIZ);
        } else if (block_address == CONFIG_FILE_BLOCK) {
            // "config" file

            leds_wait_sent();

            leds_set_reduction_mode(buffer[0]);
            leds_set_number(buffer[1], *((uint16_t*)(buffer + 2)));

        } else if (block_address < 4) {
            // filesystem metadata is read-only (in flash) to save RAM space, ignore any write to those blocks
        }

        block_address++;
    }

    // restore USB RX interrupt priority
    HAL_NVIC_SetPriority(USB_LP_CAN1_RX0_IRQn, 0, 0);
}

extern PCD_HandleTypeDef hpcd_USB_FS;
void USB_LP_CAN1_RX0_IRQHandler(void) {
    // required in order to use HAL library's USB interface
    HAL_PCD_IRQHandler(&hpcd_USB_FS);
}
